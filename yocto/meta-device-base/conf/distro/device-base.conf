## yocto/meta-device-base/conf/distro/device-base.conf
```bitbake
# Inherit settings from the default Yocto reference distro
require conf/distro/poky.conf

# Distro Identity
DISTRO = "device-base"
DISTRO_NAME = "Device Base Platform"
DISTRO_VERSION = "2.4.1"
DISTRO_CODENAME = "scarthgap"

DISTRO_FEATURES:append = " systemd usrmerge overlayfs rauc"
VIRTUAL-RUNTIME_init_manager = "systemd"
DISTRO_FEATURES_BACKFILL_CONSIDERED += "sysvinit"
VIRTUAL-RUNTIME_initscripts = "systemd-compat-units"
```

## yocto/meta-device-base/conf/layer.conf
```bitbake
# We have a conf and classes directory, add to BBPATH
BBPATH .= ":${LAYERDIR}"

# We have recipes-* directories, add to BBFILES
BBFILES += "${LAYERDIR}/recipes-*/*/*.bb \
            ${LAYERDIR}/recipes-*/*/*.bbappend"

BBFILE_COLLECTIONS += "meta-device-base"
BBFILE_PATTERN_meta-device-base = "^${LAYERDIR}/"
BBFILE_PRIORITY_meta-device-base = "6"

LAYERDEPENDS_meta-device-base = "core"
LAYERSERIES_COMPAT_meta-device-base = "scarthgap"
```

## yocto/meta-greenhouse/conf/layer.conf
```bitbake
# We have a conf and classes directory, add to BBPATH
BBPATH .= ":${LAYERDIR}"

# We have recipes-* directories, add to BBFILES
BBFILES += "${LAYERDIR}/recipes-*/*/*.bb \
            ${LAYERDIR}/recipes-*/*/*.bbappend"

BBFILE_COLLECTIONS += "meta-greenhouse"
BBFILE_PATTERN_meta-greenhouse = "^${LAYERDIR}/"
BBFILE_PRIORITY_meta-greenhouse = "6"

LAYERDEPENDS_meta-greenhouse = "core"
LAYERSERIES_COMPAT_meta-greenhouse = "scarthgap"
```
